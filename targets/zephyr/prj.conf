## prj.conf
```kconfig
CONFIG_STDOUT_CONSOLE=y
CONFIG_NEWLIB_LIBC=y
CONFIG_FLOAT=y
CONFIG_CONSOLE_HANDLER=y
CONFIG_CONSOLE_HANDLER_SHELL=y
CONFIG_ARC_INIT=n

CONFIG_GPIO=y
CONFIG_USB=y
CONFIG_USB_DW=y
CONFIG_USB_DEVICE_STACK=y
CONFIG_USB_DW_DEBUG=n
CONFIG_USB_CDC_ACM=y
CONFIG_USB_DEBUG=y
CONFIG_SERIAL=y
CONFIG_UART_INTERRUPT_DRIVEN=y
CONFIG_UART_LINE_CTRL=y
```

## src/code-memory.c
```c
/*
* Copyright (c) 2011-2012, 2014-2015 Wind River Systems, Inc.
*
* Licensed under the Apache License, Version 2.0 (the "License");
* you may not use this file except in compliance with the License.
* You may obtain a copy of the License at
*
*     http://www.apache.org/licenses/LICENSE-2.0
*
* Unless required by applicable law or agreed to in writing, software
* distributed under the License is distributed on an "AS IS" BASIS,
* WITHOUT WARRANTIES OR CONDITIONS OF ANY KIND, either express or implied.
* See the License for the specific language governing permissions and
* limitations under the License.
*/

/**
* @file
* @brief Simulates the disk access to create a writtable memory section
* to help on the transactions between the UART and the Javascript code
* this is a basic stub, do not expect a full implementation.
*/

#include <nanokernel.h>
#include <arch/cpu.h>

#include <stdio.h>
#include <stdint.h>
#include <errno.h>
#include <ctype.h>

#include <device.h>
#include <init.h>

#include "code-memory.h"
#include "ihex/kk_ihex_read.h"

static struct code_memory memory_code;

CODE *csopen(const char * filename, const char * mode) {
	memory_code.curoff = 0;
	memory_code.curend = 0;
	memory_code.maxsize = MAX_JAVASCRIPT_CODE_LEN;
	return &memory_code;
}

int csseek(CODE *stream, long int offset, int whence) {
	switch (whence) {
	case SEEK_CUR:
		stream->curoff += offset;
		break;
	case SEEK_SET:
		stream->curoff = offset;
		break;
	case SEEK_END:
		stream->curoff = stream->curend + offset;
		break;
	default:
		return (EOF);
	}

	if (stream->curoff < 0)
		stream->curoff = 0;

	if (stream->curoff >= stream->curend)
		stream->curoff = stream->curend;

	return 0;
}

size_t cswrite(const char * ptr, size_t size, size_t count, CODE * stream) {
	unsigned int t;

	size *= count;
	if (size + stream->curoff >= stream->maxsize) {
		size = stream->maxsize - stream->curoff;
	}

	char *pos = &stream->data[stream->curoff];
	for (t = 0; t < size; t++) {
		*(pos++) = *ptr++;
	}

	stream->curoff += size;
	if (stream->curend < stream->curoff)
		stream->curend = stream->curoff;

	return size;
}

size_t csread(char * ptr, size_t size, size_t count, CODE * stream) {
	return (EOF);
}

int csclose(CODE * stream) {
	return (EOF);
}

#ifdef TESTING
void main() {
	CODE *myfile;

	myfile = csopen("test.js", "rw+");
	printf(" Getting memory %p \n", myfile);

	cswrite("01234567890123456789\0", 21, sizeof(char), myfile);
	printf("[%s] %i \n", myfile->data, myfile->curoff);

	csseek(myfile, 10, SEEK_SET);
	cswrite("ABCDEFGHIK\0", 11, sizeof(char), myfile);
	printf("[%s] %i \n", myfile->data, myfile->curoff);

	csseek(myfile, 5, SEEK_SET);
	cswrite("01234", 5, sizeof(char), myfile);
	printf("[%s] %i \n", myfile->data, myfile->curoff);

	cswrite("01234\0", 6, sizeof(char), myfile);
	printf("[%s] %i \n", myfile->data, myfile->curoff);

	csseek(myfile, -10, SEEK_END);
	cswrite("012345", 5, sizeof(char), myfile);
	printf("[%s] %i \n", myfile->data, myfile->curoff);

	printf(" End \n");
}
#endif
```

## src/code-memory.h
```c
/* Copyright 2015 Intel Corporation
 *
 * Licensed under the Apache License, Version 2.0 (the "License");
 * you may not use this file except in compliance with the License.
 * You may obtain a copy of the License at
 *
 *     http://www.apache.org/licenses/LICENSE-2.0
 *
 * Unless required by applicable law or agreed to in writing, software
 * distributed under the License is distributed on an "AS IS" BASIS
 * WITHOUT WARRANTIES OR CONDITIONS OF ANY KIND, either express or implied.
 * See the License for the specific language governing permissions and
 * limitations under the License.
 */

#ifndef __CODE_MEMORY_H__
#define __CODE_MEMORY_H__

#define MAX_JAVASCRIPT_CODE_LEN 4096

struct code_memory {
	char data[MAX_JAVASCRIPT_CODE_LEN];
	uint8_t type;
	uint16_t curoff;
	uint16_t curend;
	uint16_t maxsize;
};

#define CODE struct code_memory

CODE *csopen(const char *filename, const char *mode);
int csseek(CODE *stream, long int offset, int whence);
size_t cswrite(const char *ptr, size_t size, size_t count, CODE *stream);
size_t csread(char *ptr, size_t size, size_t count, CODE *stream);
int csclose(CODE * stream);

#endif
```

## src/code_memory.c
```c
/*
* Copyright (c) 2011-2012, 2014-2015 Wind River Systems, Inc.
*
* Licensed under the Apache License, Version 2.0 (the "License");
* you may not use this file except in compliance with the License.
* You may obtain a copy of the License at
*
*     http://www.apache.org/licenses/LICENSE-2.0
*
* Unless required by applicable law or agreed to in writing, software
* distributed under the License is distributed on an "AS IS" BASIS,
* WITHOUT WARRANTIES OR CONDITIONS OF ANY KIND, either express or implied.
* See the License for the specific language governing permissions and
* limitations under the License.
*/

/**
* @file
* @brief Simulates the disk access to create a writtable memory section
* to help on the transactions between the UART and the Javascript code
* this is a basic stub, do not expect a full implementation.
*/

#include <nanokernel.h>
#include <arch/cpu.h>

#include <stdio.h>
#include <stdint.h>
#include <errno.h>
#include <ctype.h>

#include <device.h>
#include <init.h>

#include <board.h>
#include <uart.h>
#include <toolchain.h>
#include <sections.h>
#include <atomic.h>
#include <misc/printk.h>

#include "code_memory.h"
#include "ihex/kk_ihex_read.h"

static struct code_memory memory_code;

CODE *csopen(const char * filename, const char * mode) {
	memory_code.curoff = 0;
	memory_code.curend = 0;
	memory_code.maxsize = MAX_JAVASCRIPT_CODE_LEN;
	return &memory_code;
}

int csseek(CODE *stream, long int offset, int whence) {
	switch (whence) {
	case SEEK_CUR:
		stream->curoff += offset;
		break;
	case SEEK_SET:
		stream->curoff = offset;
		break;
	case SEEK_END:
		stream->curoff = stream->curend + offset;
		break;
	default:
		return (EOF);
	}

	if (stream->curoff < 0)
		stream->curoff = 0;

	if (stream->curoff >= stream->curend)
		stream->curoff = stream->curend;

	return 0;
}

size_t cswrite(const char * ptr, size_t size, size_t count, CODE * stream) {
	unsigned int t;

	size *= count;
	if (size + stream->curoff >= stream->maxsize) {
		size = stream->maxsize - stream->curoff;
	}

	char *pos = &stream->data[stream->curoff];
	for (t = 0; t < size; t++) {
		*(pos++) = *ptr++;
	}

	stream->curoff += size;
	if (stream->curend < stream->curoff)
		stream->curend = stream->curoff;

	return size;
}

size_t csread(char * ptr, size_t size, size_t count, CODE * stream) {
	return (EOF);
}

int csclose(CODE * stream) {
	return (EOF);
}

#ifdef TESTING
void main() {

	CODE *myfile;

	myfile = csopen("test.js", "rw+");
	printf(" Getting memory %p \n", myfile);

	cswrite("01234567890123456789\0", 21, sizeof(char), myfile);
	printf("[%s] %i \n", myfile->data, myfile->curoff);
	csseek(myfile, 10, SEEK_SET);
	cswrite("ABCDEFGHIK\0", 11, sizeof(char), myfile);
	printf("[%s] %i \n", myfile->data, myfile->curoff);

	csseek(myfile, -10, SEEK_END);
	cswrite("012345", 5, sizeof(char), myfile);
	printf("[%s] %i \n", myfile->data, myfile->curoff);

	printf(" End \n");
}
#endif
```

## src/code_memory.h
```c
/* Copyright 2015 Intel Corporation
 *
 * Licensed under the Apache License, Version 2.0 (the "License");
 * you may not use this file except in compliance with the License.
 * You may obtain a copy of the License at
 *
 *     http://www.apache.org/licenses/LICENSE-2.0
 *
 * Unless required by applicable law or agreed to in writing, software
 * distributed under the License is distributed on an "AS IS" BASIS
 * WITHOUT WARRANTIES OR CONDITIONS OF ANY KIND, either express or implied.
 * See the License for the specific language governing permissions and
 * limitations under the License.
 */

#ifndef __CODE_MEMORY_H__
#define __CODE_MEMORY_H__

#define MAX_JAVASCRIPT_CODE_LEN 4096

struct code_memory {
	char data[MAX_JAVASCRIPT_CODE_LEN];
	size_t curoff;
	size_t curend;
	size_t maxsize;
};

#define CODE struct code_memory

CODE *csopen(const char *filename, const char *mode);
int csseek(CODE *stream, long int offset, int whence);
size_t cswrite(const char *ptr, size_t size, size_t count, CODE *stream);
size_t csread(char *ptr, size_t size, size_t count, CODE *stream);
int csclose(CODE * stream);

#endif
```

## src/jerry-code.c
```c
/*
* Copyright (c) Intel Corporation
*
* Licensed under the Apache License, Version 2.0 (the "License");
* you may not use this file except in compliance with the License.
* You may obtain a copy of the License at
*
*     http://www.apache.org/licenses/LICENSE-2.0
*
* Unless required by applicable law or agreed to in writing, software
* distributed under the License is distributed on an "AS IS" BASIS,
* WITHOUT WARRANTIES OR CONDITIONS OF ANY KIND, either express or implied.
* See the License for the specific language governing permissions and
* limitations under the License.
*/

/**
* @file
* @brief Simple interface to load and run javascript from our code memory stash
*
* Reads a program from the ROM/RAM
*/

// Zephyr includes
#include <zephyr.h>

#include <string.h>

// JerryScript includes
#include "jerry-api.h"

#include "code-memory.h"

void javascript_run_code(const char *file_name) {
  /* Initialize engine */
    jerry_init (JERRY_INIT_EMPTY);	

	CODE *code = csopen(file_name, "r");

	if (code == NULL)
		return;

	size_t len = strlen((char *) code);

	/* Setup Global scope code */
	jerry_value_t parsed_code = jerry_parse ((const jerry_char_t *) code, len, false);
  
	if (!jerry_value_has_error_flag (parsed_code))
	{
		/* Execute the parsed source code in the Global scope */
		jerry_value_t ret_value = jerry_run (parsed_code);

		/* Returned value must be freed */
		jerry_release_value (ret_value);
	} else {
		printf("JerryScript: could not parse javascript\n");
		return;
	}

	/* Parsed source code must be freed */
	jerry_release_value (parsed_code);

	/* Cleanup engine */
	jerry_cleanup ();

	csclose(code);
}

void javascript_run_snapshot(const char *file_name) {

}
```

## src/jerry-code.h
```c
/* Copyright 2015 Intel Corporation
 *
 * Licensed under the Apache License, Version 2.0 (the "License");
 * you may not use this file except in compliance with the License.
 * You may obtain a copy of the License at
 *
 *     http://www.apache.org/licenses/LICENSE-2.0
 *
 * Unless required by applicable law or agreed to in writing, software
 * distributed under the License is distributed on an "AS IS" BASIS
 * WITHOUT WARRANTIES OR CONDITIONS OF ANY KIND, either express or implied.
 * See the License for the specific language governing permissions and
 * limitations under the License.
 */

#ifndef __JERRY_CODE_RUNNER_H__
#define __JERRY_CODE_RUNNER_H__

void javascript_run_code(const char *file_name);

#endif
```

## src/main-zephyr.c
```c
/* Copyright 2016 Intel Corporation
 *
 * Licensed under the Apache License, Version 2.0 (the "License");
 * you may not use this file except in compliance with the License.
 * You may obtain a copy of the License at
 *
 *   http://www.apache.org/licenses/LICENSE-2.0
 *
 * Unless required by applicable law or agreed to in writing, software
 * distributed under the License is distributed on an "AS IS" BASIS
 * WITHOUT WARRANTIES OR CONDITIONS OF ANY KIND, either express or implied.
 * See the License for the specific language governing permissions and
 * limitations under the License.
 */

#include <stdio.h>
#include <string.h>
#include <stdlib.h>
#include <device.h>
#include <uart.h>

#include <zephyr.h>
#include <misc/printk.h>
#include <misc/shell.h>

#include "jerry-api.h"

#if defined (CONFIG_STDOUT_CONSOLE)
#include <stdio.h>
#define PRINT       printf
#else
#include <misc/printk.h>
#define PRINT       printk
#endif

static char *source_buffer = NULL;
static unsigned char flags = 0;

#define VERBOSE 0x01

/**
 * Jerryscript simple test loop
 */
int jerryscript_test ()
{
  jerry_value_t ret_val;

  const char script[] =
  "var test=0; " \
  "for (var t=100; t<1000; t++) test+=t; " \
  "print ('Hi JS World! '+test);";

  printf ("Script [%s]\n", script);
  ret_val = jerry_eval ((jerry_char_t *) script,
      strlen (script),
      false);

  return jerry_value_has_error_flag (ret_val) ? -1 : 0;
} /* jerryscript_test */


static int shell_cmd_verbose (int argc, char *argv[])
{
  printf ("Enable verbose \n");
  flags |= VERBOSE;
  return 0;
} /* shell_cmd_verbose */


static int shell_cmd_syntax_help (int argc, char *argv[])
{
  printf ("version jerryscript & zephyr versions\n");
  return 0;
} /* shell_cmd_syntax_help */


static int shell_cmd_version (int argc, char *argv[])
{
  uint32_t version = sys_kernel_version_get ();

  printf ("Jerryscript API %d.%d\n", JERRY_API_MAJOR_VERSION, JERRY_API_MINOR_VERSION);

  printk ("Zephyr version %d.%d.%d\n", SYS_KERNEL_VER_MAJOR (version),
    SYS_KERNEL_VER_MINOR (version),
    SYS_KERNEL_VER_PATCHLEVEL (version));
  return 0;
} /* shell_cmd_version */


static int shell_cmd_test (int argc, char *argv[])
{
  return jerryscript_test ();
} /* shell_cmd_test */


static int shell_cmd_handler (int argc, char *argv[])
{
  if (argc <= 0)
  {
    return -1;
  }

  unsigned int size = 0;
  for (int t = 0; t < argc; t++)
  {
    size += strlen (argv[t]) + 1;
  }

  source_buffer = (char *) malloc (size);

  char *d = source_buffer;
  unsigned int len;

  for (int t = 0; t < argc; t++)
  {
    len = strlen (argv[t]);
    memcpy (d, argv[t], len);
    d += len;
    *d = ' ';
    d++;
  }

  * (d - 1) = '\0';

  if (flags & VERBOSE)
  {
    printf ("[%s] %lu\n", source_buffer, strlen (source_buffer));
  }

  jerry_value_t ret_val;

  ret_val = jerry_eval ((jerry_char_t *) source_buffer,
    strlen (source_buffer),
    false);

  free (source_buffer);

  if (jerry_value_has_error_flag (ret_val))
  {
    printf ("Failed to run JS\n");
  }

  jerry_release_value (ret_val);

  return 0;
} /* shell_cmd_handler */

#define SHELL_COMMAND(name,cmd) { name, cmd }

const struct shell_cmd commands[] =
{
  SHELL_COMMAND ("syntax", shell_cmd_syntax_help),
  SHELL_COMMAND ("version", shell_cmd_version),
  SHELL_COMMAND ("test", shell_cmd_test),
  SHELL_COMMAND ("verbose", shell_cmd_verbose),
  SHELL_COMMAND (NULL, NULL)
};

static volatile bool data_transmitted;
static volatile bool data_arrived;
static	char data_buf[64];

static void interrupt_handler(struct device *dev)
{
	uart_irq_update(dev);

	if (uart_irq_tx_ready(dev)) {
		data_transmitted = true;
	}

	if (uart_irq_rx_ready(dev)) {
		data_arrived = true;
	}
}

static void write_data(struct device *dev, const char *buf, int len)
{
	uart_irq_tx_enable(dev);

	data_transmitted = false;
	uart_fifo_fill(dev, buf, len);
	while (data_transmitted == false)
		;

	uart_irq_tx_disable(dev);
}

static void read_and_echo_data(struct device *dev, int *bytes_read)
{
	while (data_arrived == false)
		;

	data_arrived = false;

	/* Read all data and echo it back */
	while ((*bytes_read = uart_fifo_read(dev,
		data_buf, sizeof(data_buf)))) {
		write_data(dev, data_buf, *bytes_read);
	}
}

static const char *banner1 = "Send characters to the UART device\r\n";
static const char *banner2 = "Characters read:\r\n";

void main (void)
{
  printf ("Jerry Compilation " __DATE__ " " __TIME__ "\n");
  jerry_init (JERRY_INIT_EMPTY);
  shell_register_app_cmd_handler (shell_cmd_handler);
  shell_init ("js> ", commands);

  struct device *dev;
  uint32_t baudrate, bytes_read, dtr = 0;
  int ret;

  dev = device_get_binding(CONFIG_CDC_ACM_PORT_NAME);
  if (!dev) {
	  PRINT("CDC ACM device not found\n");
	  return;
  }

  PRINT("Wait for DTR\n");
  while (1) {
	  uart_line_ctrl_get(dev, LINE_CTRL_DTR, &dtr);
	  if (dtr)
		  break;
  }
  PRINT("DTR set, start test\n");

  /* They are optional, we use them to test the interrupt endpoint */
  ret = uart_line_ctrl_set(dev, LINE_CTRL_DCD, 1);
  if (ret)
	  PRINT("Failed to set DCD, ret code %d\n", ret);

  ret = uart_line_ctrl_set(dev, LINE_CTRL_DSR, 1);
  if (ret)
	  PRINT("Failed to set DSR, ret code %d\n", ret);

  /* Wait 1 sec for the host to do all settings */
  sys_thread_busy_wait(1000000);

  ret = uart_line_ctrl_get(dev, LINE_CTRL_BAUD_RATE, &baudrate);
  if (ret)
	  PRINT("Failed to get baudrate, ret code %d\n", ret);
  else
	  PRINT("Baudrate detected: %d\n", baudrate);

  uart_irq_callback_set(dev, interrupt_handler);
  write_data(dev, banner1, strlen(banner1));
  write_data(dev, banner2, strlen(banner2));

  /* Enable rx interrupts */
  uart_irq_rx_enable(dev);

  /* Echo the received data */
  while (1) {
	  read_and_echo_data(dev, &bytes_read);
  }

  /* Don't call jerry_cleanup() here, as shell_init() returns after setting
     up background task to process shell input, and that task calls
     shell_cmd_handler(), etc. as callbacks. This processing happens in
     the infinite loop, so JerryScript doesn't need to be de-initialized. */
} /* main */
```

## src/uart-uploader.c
```c
/*
* Copyright (c) 2011-2012, 2014-2015 Wind River Systems, Inc.
*
* Licensed under the Apache License, Version 2.0 (the "License");
* you may not use this file except in compliance with the License.
* You may obtain a copy of the License at
*
*     http://www.apache.org/licenses/LICENSE-2.0
*
* Unless required by applicable law or agreed to in writing, software
* distributed under the License is distributed on an "AS IS" BASIS,
* WITHOUT WARRANTIES OR CONDITIONS OF ANY KIND, either express or implied.
* See the License for the specific language governing permissions and
* limitations under the License.
*/

/**
* @file
* @brief UART-driven uploader
*
* Reads a program from the uart using Intel HEX format.
*
* Designed to be used from Javascript or a ECMAScript object file.
*
* Hooks into the printk and fputc (for printf) modules. Poll driven.
*/

#include <nanokernel.h>
#include <arch/cpu.h>

#include <stdio.h>
#include <stdint.h>
#include <string.h>
#include <errno.h>
#include <ctype.h>

#include <device.h>
#include <init.h>

#include <board.h>
#include <uart.h>
#include <toolchain.h>
#include <sections.h>
#include <atomic.h>
#include <misc/printk.h>

#include "code-memory.h"
#include "jerry-code.h"

#include "ihex/kk_ihex_read.h"

#define CONFIG_UART_UPLOAD_HANDLER_STACKSIZE 2000

#define STACKSIZE CONFIG_UART_UPLOAD_HANDLER_STACKSIZE

static char __stack fiberStack[STACKSIZE];

//#define DEBUG_UART

/*
 * Contains the pointer to the memory where the code will be uploaded
 * using the stub interface at code_memory.c
 */
static CODE *code_memory = NULL;

/**************************** UART CAPTURE **********************************/

static struct ihex_state ihex;

static struct nano_fifo avail_queue;
static struct nano_fifo lines_queue;

static struct device *uart_uploader_dev;

/* Control characters for testing and debugging */
#define ESC                0x1b
#define DEL                0x7f

#define MAX_LINE_LEN 128
struct uart_uploader_input {
	int _unused;
	char line[MAX_LINE_LEN];
};

#define MAX_LINES_QUEUED 8
static struct uart_uploader_input buf[MAX_LINES_QUEUED];

#if defined(CONFIG_PRINTK) || defined(CONFIG_STDOUT_CONSOLE)

void uart_clear(void) {
	int i;
	for (i = 0; i < MAX_LINES_QUEUED; i++) {
		nano_fifo_put(&avail_queue, &buf[i]);
	}
}

/**
* Outputs both line feed and carriage return in the case of a '\n'.
* @param c Character to output
* @return The character passed as input.
*/

static int uploader_out(int c)
{
	uart_poll_out(uart_uploader_dev, (unsigned char)c);
	if ('\n' == c) {
		uart_poll_out(uart_uploader_dev, (unsigned char)'\r');
	}
	return c;
}

#endif

extern void __stdout_hook_install(int(*hook)(int));

static int read_uart(struct device *uart, uint8_t *buf, unsigned int size)
{
	int rx;
	rx = uart_fifo_read(uart, buf, size);
	if (rx < 0) {
		/* Overrun issue. Stop the UART */
		uart_irq_rx_disable(uart);
		return -EIO;
	}
	return rx;
}

static uint8_t cur;

void uart_uploader_isr(struct device *unused)
{
	ARG_UNUSED(unused);

	while (uart_irq_update(uart_uploader_dev) &&
		uart_irq_is_pending(uart_uploader_dev)) {
		static struct uart_uploader_input *cmd = NULL;
		uint8_t byte;
		int rx;

		if (!uart_irq_rx_ready(uart_uploader_dev)) {
			continue;
		}

		/* Character(s) have been received */

		rx = read_uart(uart_uploader_dev, &byte, 1);
		if (rx < 0) {
			return;
		}

		if (uart_irq_input_hook(uart_uploader_dev, byte) != 0) {
			/*
			* The input hook indicates that no further processing
			* should be done by this handler.
			*/
			return;
		}

		if (!cmd) {
			cmd = nano_isr_fifo_get(&avail_queue, TICKS_NONE);
			if (!cmd) {
				//uart_poll_out(uart_uploader_dev, 'c');
				return;
			}
		}

		/* Handle special control characters */
		if (!isprint(byte)) {
			switch (byte) {
			case DEL:
				cmd->line[cur] = '\0';
				printf("[%s]%d\n", cmd->line, cur);
				break;
			case ESC:
				// Clear
				printf("[CLR]\n");
				uart_clear();
				break;
			case '\r':
				cur = 0;
				printf("[ACK]\n");
				break;
			case '\n':
				cmd->line[cur] = '\0';
				nano_isr_fifo_put(&lines_queue, cmd);
				cur = 0;
				cmd = NULL;
				break;
			default:
				break;
			}

			continue;
		}

		/* Flush the data into the buffer if end of line or each 32 bytes */
		cmd->line[cur++] = byte;

		if (cur >= MAX_LINE_LEN) {
			cmd->line[cur] = '\0';
			nano_isr_fifo_put(&lines_queue, cmd);
			cur = 0;
			cmd = NULL;
		}
	}
}

void uploader_input_init(void) {
	uint8_t c;

	uart_irq_rx_disable(uart_uploader_dev);
	uart_irq_tx_disable(uart_uploader_dev);

	uart_irq_callback_set(uart_uploader_dev, uart_uploader_isr);

	/* Drain the fifo */
	while (uart_irq_rx_ready(uart_uploader_dev)) {
		uart_fifo_read(uart_uploader_dev, &c, 1);
	}
	uart_irq_rx_enable(uart_uploader_dev);
}

int8_t upload_state = 0;
#define UPLOAD_START       0
#define UPLOAD_IN_PROGRESS 1
#define UPLOAD_FINISHED    2
#define UPLOAD_ERROR       -1

/*
 * Negotiate a re-upload
 */
void uart_handle_upload_error() {
	printf("[Download Error]\n");
}

void uart_uploader_runner(int arg1, int arg2)
{
	const char *code_name = "test.js";

	struct uart_uploader_input *cmd;
	while (1) {
		upload_state = UPLOAD_START;
		printf("[Waiting for data]\n");
		ihex_begin_read(&ihex);
		code_memory = csopen(code_name, "w+");

		while (upload_state != UPLOAD_FINISHED) {
			cmd = nano_fiber_fifo_get(&lines_queue, TICKS_UNLIMITED);

#ifdef DEBUG_UART
			printf("[Read][%s]\n", cmd->line);
#endif
			ihex_read_bytes(&ihex, cmd->line, strlen(cmd->line));

			if (upload_state == UPLOAD_ERROR) {
				uart_handle_upload_error();
				break;
			}

			nano_fiber_fifo_put(&avail_queue, cmd);
		}

		if (upload_state == UPLOAD_FINISHED) {
			csclose(code_memory);
			ihex_end_read(&ihex);
			javascript_run_code(code_name);
		}

	}
}

/* Data received from the buffer */
ihex_bool_t ihex_data_read(struct ihex_state *ihex,
	ihex_record_type_t type,
	ihex_bool_t checksum_error) {

	if (checksum_error) {
		upload_state = UPLOAD_ERROR;
		return false;
	};

	if (type == IHEX_DATA_RECORD) {
		upload_state = UPLOAD_IN_PROGRESS;
		unsigned long address = (unsigned long) IHEX_LINEAR_ADDRESS(ihex);
		ihex->data[ihex->length] = 0;
#ifdef DEBUG_UART
		printf("%d::%d:: %s \n", (int)address, ihex->length, ihex->data);
#endif
		csseek(code_memory, address, SEEK_SET);
		cswrite(ihex->data, ihex->length, 1, code_memory);
	}
	else if (type == IHEX_END_OF_FILE_RECORD) {
		printf("[EOF]\n");
		upload_state = UPLOAD_FINISHED;
	}
	return true;
}

/* Setup code uploader */
void uart_uploader_init(void) {

	nano_fifo_init(&lines_queue);
	nano_fifo_init(&avail_queue);
	uart_clear();

	task_fiber_start(fiberStack, STACKSIZE, uart_uploader_runner, 0, 0, 7, 0);

	/* Register uart handler */
	uploader_input_init();

} /* uart_uploader_init */

/**
*
* @brief Initialize one UART as the uploader/debug port
*
* @return 0 if successful, otherwise failed.
*/
static int uart_serial_uploader_init(struct device *arg)
{
	ARG_UNUSED(arg);
	uart_uploader_dev = device_get_binding(CONFIG_UART_CONSOLE_ON_DEV_NAME);

	/* Install printk / stdout hook for UART uploader output */
	__stdout_hook_install(uploader_out);
	return 0;
}

/* UART uploader initializes after the UART device itself */
SYS_INIT(uart_serial_uploader_init,
	SECONDARY,
	CONFIG_UART_CONSOLE_INIT_PRIORITY);
```

## src/uart-uploader.h
```c
/* Copyright 2015 Intel Corporation
 *
 * Licensed under the Apache License, Version 2.0 (the "License");
 * you may not use this file except in compliance with the License.
 * You may obtain a copy of the License at
 *
 *     http://www.apache.org/licenses/LICENSE-2.0
 *
 * Unless required by applicable law or agreed to in writing, software
 * distributed under the License is distributed on an "AS IS" BASIS
 * WITHOUT WARRANTIES OR CONDITIONS OF ANY KIND, either express or implied.
 * See the License for the specific language governing permissions and
 * limitations under the License.
 */

#ifndef __UART_UPLOADER_H__
#define __UART_UPLOADER_H__

// TODO @sergioamr Move this definition to the configuration
#define CONFIG_UART_UPLOAD_HANDLER_STACKSIZE 1024

void code_runner(int arg1, int arg2);
void uart_uploader_init(void);

#endif
```

## src/uart_uploader.c
```c
/*
* Copyright (c) 2011-2012, 2014-2015 Wind River Systems, Inc.
*
* Licensed under the Apache License, Version 2.0 (the "License");
* you may not use this file except in compliance with the License.
* You may obtain a copy of the License at
*
*     http://www.apache.org/licenses/LICENSE-2.0
*
* Unless required by applicable law or agreed to in writing, software
* distributed under the License is distributed on an "AS IS" BASIS,
* WITHOUT WARRANTIES OR CONDITIONS OF ANY KIND, either express or implied.
* See the License for the specific language governing permissions and
* limitations under the License.
*/

/**
* @file
* @brief UART-driven uploader
*
* Reads a program from the uart using Intel HEX format.
*
* Designed to be used from Javascript or a ECMAScript object file.
*
* Hooks into the printk and fputc (for printf) modules. Poll driven.
*/

#include <nanokernel.h>
#include <arch/cpu.h>

#include <stdio.h>
#include <stdint.h>
#include <string.h>
#include <errno.h>
#include <ctype.h>

#include <device.h>
#include <init.h>

#include <board.h>
#include <uart.h>
#include <toolchain.h>
#include <sections.h>
#include <atomic.h>
#include <misc/printk.h>

#include "code_memory.h"
#include "ihex/kk_ihex_read.h"

#define CONFIG_UART_UPLOAD_HANDLER_STACKSIZE 2000

#define STACKSIZE CONFIG_UART_UPLOAD_HANDLER_STACKSIZE

static char __stack fiberStack[STACKSIZE];

/*
 * Contains the pointer to the memory where the code will be uploaded
 * using the stub interface at code_memory.c
 */
static CODE *code_memory = NULL;

/**************************** UART CAPTURE **********************************/

static struct ihex_state ihex;

static struct nano_fifo avail_queue;
static struct nano_fifo lines_queue;

static struct device *uart_uploader_dev;

/* Control characters for testing and debugging */
#define ESC                0x1b
#define DEL                0x7f

#define MAX_LINE_LEN 128
struct uart_uploader_input {
	int _unused;
	char line[MAX_LINE_LEN];
};

#define MAX_LINES_QUEUED 8
static struct uart_uploader_input buf[MAX_LINES_QUEUED];

#if defined(CONFIG_PRINTK) || defined(CONFIG_STDOUT_CONSOLE)

void uart_clear(void) {
	int i;
	for (i = 0; i < MAX_LINES_QUEUED; i++) {
		nano_fifo_put(&avail_queue, &buf[i]);
	}
}

/**
* Outputs both line feed and carriage return in the case of a '\n'.
* @param c Character to output
* @return The character passed as input.
*/

static int uploader_out(int c)
{
	uart_poll_out(uart_uploader_dev, (unsigned char)c);
	if ('\n' == c) {
		uart_poll_out(uart_uploader_dev, (unsigned char)'\r');
	}
	return c;
}

#endif

extern void __stdout_hook_install(int(*hook)(int));

static int read_uart(struct device *uart, uint8_t *buf, unsigned int size)
{
	int rx;
	rx = uart_fifo_read(uart, buf, size);
	if (rx < 0) {
		/* Overrun issue. Stop the UART */
		uart_irq_rx_disable(uart);
		return -EIO;
	}
	return rx;
}

static uint8_t cur;

void uart_uploader_isr(struct device *unused)
{
	ARG_UNUSED(unused);

	while (uart_irq_update(uart_uploader_dev) &&
		uart_irq_is_pending(uart_uploader_dev)) {
		static struct uart_uploader_input *cmd = NULL;
		uint8_t byte;
		int rx;

		if (!uart_irq_rx_ready(uart_uploader_dev)) {
			continue;
		}

		/* Character(s) have been received */

		rx = read_uart(uart_uploader_dev, &byte, 1);
		if (rx < 0) {
			return;
		}

		if (uart_irq_input_hook(uart_uploader_dev, byte) != 0) {
			/*
			* The input hook indicates that no further processing
			* should be done by this handler.
			*/
			return;
		}

		if (!cmd) {
			cmd = nano_isr_fifo_get(&avail_queue, TICKS_NONE);
			if (!cmd) {
				//uart_poll_out(uart_uploader_dev, 'c');
				return;
			}
		}

		/* Handle special control characters */
		if (!isprint(byte)) {
			switch (byte) {
			case DEL:
				cmd->line[cur] = '\0';
				printf("[%s]%d\n", cmd->line, cur);
				break;
			case ESC:
				printf("[Clear]\n");
				uart_clear();
				break;
			case '\r':
				cur = 0;
				printf("[ACK]\n");
				break;
			case '\n':
				cmd->line[cur] = '\0';
				nano_isr_fifo_put(&lines_queue, cmd);
				cur = 0;
				cmd = NULL;
				break;
			default:
				break;
			}

			continue;
		}

		/* Flush the data into the buffer if end of line or each 32 bytes */
		cmd->line[cur++] = byte;

		if (cur >= MAX_LINE_LEN) {
			cmd->line[cur] = '\0';
			nano_isr_fifo_put(&lines_queue, cmd);
			cur = 0;
			cmd = NULL;
		}
	}
}

void uploader_input_init(void) {
	uint8_t c;

	uart_irq_rx_disable(uart_uploader_dev);
	uart_irq_tx_disable(uart_uploader_dev);

	uart_irq_callback_set(uart_uploader_dev, uart_uploader_isr);

	/* Drain the fifo */
	while (uart_irq_rx_ready(uart_uploader_dev)) {
		uart_fifo_read(uart_uploader_dev, &c, 1);
	}
	uart_irq_rx_enable(uart_uploader_dev);
}

int8_t upload_state = 0;
#define UPLOAD_START       0
#define UPLOAD_IN_PROGRESS 1
#define UPLOAD_FINISHED    2
#define UPLOAD_ERROR       -1

void uart_uploader_runner(int arg1, int arg2)
{
	struct uart_uploader_input *cmd;
	while (1) {
		upload_state = UPLOAD_START;
		printf("[Waiting for data]\n");
		ihex_begin_read(&ihex);
		code_memory = csopen("test.js", "rw+");

		while (upload_state != UPLOAD_FINISHED) {
			cmd = nano_fiber_fifo_get(&lines_queue, TICKS_UNLIMITED);
			printf("[Read][%s]\n", cmd->line);
			ihex_read_bytes(&ihex, cmd->line, strlen(cmd->line));

			if (upload_state == UPLOAD_ERROR) {
				printf("[Download Error]\n");
				break;
			}
			nano_fiber_fifo_put(&avail_queue, cmd);
		}

		if (upload_state == UPLOAD_FINISHED)
			csclose(code_memory);
		ihex_end_read(&ihex);
	}
}

/* Data received from the buffer */
ihex_bool_t ihex_data_read(struct ihex_state *ihex,
	ihex_record_type_t type,
	ihex_bool_t checksum_error) {
	if (type == IHEX_DATA_RECORD) {
		upload_state = UPLOAD_IN_PROGRESS;
		unsigned long address = (unsigned long)IHEX_LINEAR_ADDRESS(ihex);
		ihex->data[ihex->length] = 0;
		printf("%d::%d:: %s \n", (int)address, ihex->length, ihex->data);
		csseek(code_memory, address, SEEK_SET);
		cswrite(ihex->data, ihex->length, 1, code_memory);
	}
	else if (type == IHEX_END_OF_FILE_RECORD) {
		printf("[End of file]\n");
		upload_state = UPLOAD_FINISHED;
	}
	return true;
}

/* Setup code uploader */
void uart_uploader_init(void) {

	nano_fifo_init(&lines_queue);
	nano_fifo_init(&avail_queue);
	uart_clear();

	task_fiber_start(fiberStack, STACKSIZE, uart_uploader_runner, 0, 0, 7, 0);

	/* Register uart handler */
	uploader_input_init();

} /* uart_uploader_init */

/**
*
* @brief Initialize one UART as the uploader/debug port
*
* @return 0 if successful, otherwise failed.
*/
static int uart_serial_uploader_init(struct device *arg)
{
	ARG_UNUSED(arg);
	uart_uploader_dev = device_get_binding(CONFIG_UART_CONSOLE_ON_DEV_NAME);

	/* Install printk / stdout hook for UART uploader output */
	__stdout_hook_install(uploader_out);
	return 0;
}

/* UART uploader initializes after the UART device itself */
SYS_INIT(uart_serial_uploader_init,
	SECONDARY,
	CONFIG_UART_CONSOLE_INIT_PRIORITY);
```
